## conf/layer.conf
```bitbake
# We have a conf and classes directory, add to BBPATH
BBPATH .= ":${LAYERDIR}"

# We have recipes-* directories, add to BBFILES
BBFILES += "${LAYERDIR}/recipes-*/*/*.bb \
            ${LAYERDIR}/recipes-*/*/*.bbappend"

BBFILE_COLLECTIONS += "meta-odroid-rk"
BBFILE_PATTERN_meta-odroid-rk = "^${LAYERDIR}/"
BBFILE_PRIORITY_meta-odroid-rk = "10"
LAYERVERSION_meta-odroid-rk = "4"
LAYERSERIES_COMPAT_meta-odroid-rk = "scarthgap"
```

## conf/machine/odroid-m1.conf
```bitbake
# Copyright (c) 2024, Hardkernel Co., Ltd
# Released under the MIT license (see COPYING.MIT for the terms)

#@TYPE: Machine
#@NAME: ODROID-M1

require conf/machine/rockchip-rk3566-evb.conf
require conf/machine/odroid.inc


PREFERRED_VERSION_linux-rockchip := "6.1%"
LINUXLIBCVERSION := "6.1-custom%"

KERNEL_DEVICETREE = "rockchip/rk3568-odroid-m1.dtb"

IMAGE_BOOT_FILES += "Image rk3568-odroid-m1.dtb" 

WKS_FILE ?= "odroid-m1.wks"
```

## conf/machine/odroid-m1s.conf
```bitbake
# Copyright (c) 2024, Hardkernel Co., Ltd
# Released under the MIT license (see COPYING.MIT for the terms)

#@TYPE: Machine
#@NAME: ODROID-M1S

require conf/machine/rockchip-rk3566-evb.conf

PREFERRED_VERSION_linux-rockchip := "6.1%"
LINUXLIBCVERSION := "6.1-custom%"

KERNEL_DEVICETREE = "rockchip/rk3568-odroid-m1.dtb"

IMAGE_BOOT_FILES += "Image rk3568-odroid-m1.dtb" 

require conf/machine/odroid.inc
```

## conf/machine/odroid-m2.conf
```bitbake
# Copyright (c) 2024, Hardkernel Co., Ltd
# Released under the MIT license (see COPYING.MIT for the terms)

#@TYPE: Machine
#@NAME: ODROID-M2

require conf/machine/rockchip-rk3588.inc

PREFERRED_VERSION_linux-rockchip := "6.1%"
LINUXLIBCVERSION := "6.1-custom%"

KERNEL_DEVICETREE = "rockchip/rk3588-odroid-m2.dtb"

IMAGE_BOOT_FILES += "Image rk3588-odroid-m2.dtb" 

require conf/machine/odroid.inc

WKS_FILE ?= "odroid-image.wks"
```

## conf/machine/odroid.inc
```bitbake
ERROR_QA:remove = "patch-status"
KERNEL_IMAGETYPE = "Image"
IMAGE_FSTYPES ?= " ext4 wic wic.xz" 
```

## wic/odroid-image.wks
```
bootloader --ptable gpt

part --source rawcopy --sourceparams="file=idblock.bin" --align 32 --no-table
part --source rawcopy --sourceparams="file=uboot.img" --part-name uboot --offset 2M

# fat partition, with 100Mb
part /boot --source bootimg-partition --ondisk mmcblk --fstype=vfat --label boot --active --align 1024 --fixed-size 100 --use-uuid

# Rootfs partition
part / --source rootfs --ondisk mmcblk --fstype ext4 --label rootfs --align 4096 --use-uuid --fixed-size=2048
```

## wic/odroid-m1.wks
```
bootloader --ptable gpt

# fat partition, with 100Mb
part /boot --source bootimg-partition --ondisk mmcblk --fstype=vfat --label boot --active --align 1024 --fixed-size 100 --use-uuid

# Rootfs partition
part / --source rootfs --ondisk mmcblk --fstype ext4 --label rootfs --align 4096 --use-uuid --fixed-size=2048
```
